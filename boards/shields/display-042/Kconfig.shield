## boards/shields/display-042/Kconfig.shield
```kconfig
# Copyright (c) 2024 The ZMK Contributors
# SPDX-License-Identifier: MIT

config SHIELD_DISPLAY_042
	def_bool $(shields_list_contains,display_042)
```

## boards/shields/display-091-drumh/Kconfig.shield
```kconfig
# Copyright (c) 2024 The ZMK Contributors
# SPDX-License-Identifier: MIT

config SHIELD_DISPLAY_091_DRUMH
	def_bool $(shields_list_contains,display_091_drumh)
```

## boards/shields/kawvin_36/Kconfig.defconfig
```kconfig
# Copyright (c) 2023 The ZMK Contributors
# SPDX-License-Identifier: MIT

if SHIELD_KAWVIN_36_LEFT || SHIELD_KAWVIN_36_DONGLE

config ZMK_KEYBOARD_NAME
    default "Kawvin_36"

config ZMK_SPLIT_ROLE_CENTRAL
    default y

endif # SHIELD_KAWVIN_36_LEFT || SHIELD_KAWVIN_36_DONGLE

if SHIELD_KAWVIN_36_LEFT || SHIELD_KAWVIN_36_RIGHT || SHIELD_KAWVIN_36_DONGLE

config ZMK_SPLIT
    default y

choice BT_CTLR_TX_PWR
    default BT_CTLR_TX_PWR_PLUS_8
endchoice

choice ZMK_DISPLAY_WORK_QUEUE
    default ZMK_DISPLAY_WORK_QUEUE_DEDICATED
endchoice

endif 

if SHIELD_KAWVIN_36_LEFT || SHIELD_KAWVIN_36_RIGHT 
config ZMK_RGB_UNDERGLOW
    select WS2812_STRIP
    select SPI

if ZMK_DISPLAY

config SSD1306
    default y

config I2C
    default y

if LVGL

config LV_Z_VDB_SIZE
    default 64

config LV_DPI_DEF
    default 148

config LV_Z_BITS_PER_PIXEL
    default 1

choice LV_COLOR_DEPTH
    default LV_COLOR_DEPTH_1
endchoice

endif # LVGL

endif # ZMK_DISPLAY

endif # SHIELD_KAWVIN_36_LEFT || SHIELD_KAWVIN_36_RIGHT
```

## boards/shields/kawvin_36/Kconfig.shield
```kconfig
# Copyright (c) 2023 The ZMK Contributors
# SPDX-License-Identifier: MIT

config SHIELD_KAWVIN_36_LEFT
    def_bool $(shields_list_contains,kawvin_36_left)

config SHIELD_KAWVIN_36_RIGHT
    def_bool $(shields_list_contains,kawvin_36_right)
```

## boards/shields/kawvin_46/Kconfig.defconfig
```kconfig
# Copyright (c) 2023 The ZMK Contributors
# SPDX-License-Identifier: MIT

if SHIELD_KAWVIN_46_LEFT

config ZMK_KEYBOARD_NAME
    default "Kawvin_46"

config ZMK_SPLIT_ROLE_CENTRAL
    default y

endif # SHIELD_KAWVIN_46_LEFT

if SHIELD_KAWVIN_46_LEFT || SHIELD_KAWVIN_46_RIGHT

config ZMK_SPLIT
    default y

config ZMK_RGB_UNDERGLOW
    select WS2812_STRIP
    select SPI

endif # SHIELD_KAWVIN_46_LEFT || SHIELD_KAWVIN_46_RIGHT
```

## boards/shields/kawvin_46/Kconfig.shield
```kconfig
# Copyright (c) 2023 The ZMK Contributors
# SPDX-License-Identifier: MIT

config SHIELD_KAWVIN_46_LEFT
    def_bool $(shields_list_contains,kawvin_46_left)

config SHIELD_KAWVIN_46_RIGHT
    def_bool $(shields_list_contains,kawvin_46_right)
```

## config/west.yml
```yaml
manifest:
  remotes:
    - name: zmkfirmware
      # url-base: https://github.com/zmkfirmware
      url-base: https://github.com/petejohanson  # 添加鼠标的修订
    # Additional modules containing boards/shields/custom code can be listed here as well
    # See https://docs.zephyrproject.org/3.2.0/develop/west/manifest.html#projects
  projects:
    - name: zmk
      remote: zmkfirmware
      # revision: main
      revision: feat/pointers-move-scroll  # 添加鼠标的修订
      import: app/west.yml
  self:
    path: config
```
